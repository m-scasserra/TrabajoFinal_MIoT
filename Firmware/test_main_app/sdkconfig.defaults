## Firmware/test_main_app/sdkconfig.defaults
```kconfig
CONFIG_IDF_TARGET="esp32s3"
CONFIG_FREERTOS_HZ=1000
CONFIG_ESP_MAIN_TASK_STACK_SIZE=8192
CONFIG_UNITY_ENABLE_COLOR=y
CONFIG_ESP_TASK_WDT_EN=n
```
